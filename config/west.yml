## config/west.yml
```yaml
manifest:
  remotes:
    - name: zmkfirmware
      url-base: https://github.com/zmkfirmware
    - name: AlexanderZhou39
      url-base: https://github.com/AlexanderZhou39
  projects:
    - name: zmk
      remote: zmkfirmware
      revision: main
      import: app/west.yml
    - name: zmk-pmw3610-driver
      remote: AlexanderZhou39
      revision: main
      
  self:
    path: config
```
